
/dts-v1/;

#include "saber.dtsi"

/ {
	#address-cells = <1>;
	#size-cells = <1>;
	model = "saber2020";
	compatible = "saber,saber2020";

	chosen {
		bootargs = "earlycon console=tvtty";
		stdout-path = "serial0";
	};
};

