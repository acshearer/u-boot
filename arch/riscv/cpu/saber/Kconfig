## arch/riscv/cpu/saber/Kconfig
```kconfig
config SABER_RISCV
	bool
	select ARCH_EARLY_INIT_R
	imply CPU
	imply CPU_RISCV
	imply RISCV_TIMER
	imply SIFIVE_CLINT if (RISCV_MMODE || SPL_RISCV_MMODE)
	imply CMD_CPU
	imply SPL_CPU_SUPPORT
	imply SPL_OPENSBI
	imply SPL_LOAD_FIT
	imply SABER_SBI_SERIAL
	
```

## board/saber/saber2020/Kconfig
```kconfig
if TARGET_SABER_SABER2020

config SYS_BOARD
	default "saber2020"

config SYS_VENDOR
	default "saber"

config SYS_CPU
	default "saber"

config SYS_CONFIG_NAME
	default "saber-saber2020"

config SYS_TEXT_BASE
	default 0x80400000

config DEFAULT_DEVICE_TREE
	default "saber"

config BOARD_SPECIFIC_OPTIONS # dummy
	def_bool y
	select SABER_RISCV

endif
```

## configs/saber_saber2020_defconfig
```kconfig
CONFIG_TARGET_SABER_SABER2020=y

CONFIG_ENV_VARS_UBOOT_CONFIG=y

# ISA
CONFIG_RISCV=y
CONFIG_ARCH_RV32I=y
CONFIG_RISCV_SMODE=y
CONFIG_RISCV_ISA_A=y
CONFIG_RISCV_ISA_C=n
CONFIG_RISCV_ISA_M=n

# CPU and Device Tree
CONFIG_CPU=y
CONFIG_DEFAULT_DEVICE_TREE=saber
CONFIG_OF_CONTROL=y
CONFIG_OF_EMBED=y
CONFIG_STACK_SIZE=0x10000

# Disable net
CONFIG_NET=n

# SBI
CONFIG_SBI=y
CONFIG_SBI_V01=y
CONFIG_SBI_V02=y
CONFIG_SABER_SBI_SERIAL=y

# Machine
CONFIG_NR_DRAM_BANKS=1

# BOOT
CONFIG_CMD_BOOTEFI=n
CONFIG_EFI_LOADER=n

# SPI
CONFIG_SPI=y
CONFIG_SPI_MEM=y
```
